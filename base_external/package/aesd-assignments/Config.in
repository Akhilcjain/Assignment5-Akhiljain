## base_external/package/aesd-assignments/Config.in
```kconfig
config BR2_PACKAGE_AESD_ASSIGNMENTS
	bool "aesd-assignments"
	help
	  Includes the server executable, and the startup script to start socket application on startup.
	  Used to understand buildroot external trees and package builds.
```
